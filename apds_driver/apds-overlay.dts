/dts-v1/;
/plugin/;

/ {
    compatible = "brcm,bcm2835";  // RPi4 SoC

    fragment@0 {
        target = <&i2c1>;   // RPi4 secondary I2C bus (i2c-1)
        __overlay__ {
            #address-cells = <1>;
            #size-cells = <0>;

            apds@39 {
                compatible = "parth,apds";    // Must match your driver's .name
                reg = <0x39>;                 // I2C address of APDS sensor
            };
        };
    };
};

